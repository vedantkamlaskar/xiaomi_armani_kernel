## Documentation/devicetree/bindings/arm/msm/msm_thermal.txt
```
MSM thermal driver (MSM_THERMAL)

MSM_THERMAL is a kernel platform driver which regulates thermal conditions
on the device during kernel boot. The goal of MSM_THERMAL is to prevent the
temperature of the system from exceeding a thermal limit at which it cannot
operate.

Driver checks the current temperature of the system (using thermal_zone 5 by default)
and limits the frequency of CPU cores due to reaches of the limit.
It's logic is pretty simple: when the temp > temp_limit, current_freq = limit_freq.

As the device has a lot of frequency steps, it's not enough to just limit
the frequency after reaching the limit. So, thermal levels are hooked as
the CPU max frequency after the temp goes up to thermal_limit+thermal_level_diff

The devicetree representation of the MSM_THERMAL block should be:

Required properties

- compatible: "qcom,msm-thermal"
- qcom,sensor-id: The id of the TSENS sensor polled for temperature.
			Typically the sensor closest to CPU0.

Example:

	qcom,msm-thermal {
		compatible = "qcom,msm-thermal";
		qcom,sensor-id = <5>;
	};
```
